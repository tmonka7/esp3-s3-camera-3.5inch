## components/bsp/Kconfig.projbuild
```kconfig
menu "Board Support (ESP32-S3-Touch-LCD-3.5-C)"

    config BSP_PINS_VERIFIED
        bool "I have checked every pin below against my board schematic"
        default n
        help
            The camera DVP pins below are taken from the Waveshare wiki for
            ESP32-S3-Touch-LCD-3.5 and are known good. The LCD, I2C, TF-card
            and RS485 pins are best-known defaults that Waveshare publishes
            only as symbolic names, so they MUST be checked against
            ESP32-S3-Touch-LCD-3.5-Schematic.pdf before you trust them.

            Until you enable this option the firmware prints a loud warning at
            boot. Enabling it changes nothing else.

    menu "Display (ST7796, SPI)"
        config BSP_LCD_SPI_HOST
            int "SPI host (1 = SPI2_HOST, 2 = SPI3_HOST)"
            range 1 2
            default 1
        config BSP_LCD_PIN_SCLK
            int "LCD SCLK"
            default 5
        config BSP_LCD_PIN_MOSI
            int "LCD MOSI"
            default 1
        config BSP_LCD_PIN_MISO
            int "LCD MISO (-1 if not wired)"
            default 2
        config BSP_LCD_PIN_CS
            int "LCD CS"
            default 12
        config BSP_LCD_PIN_DC
            int "LCD DC"
            default 3
        config BSP_LCD_PIN_RST
            int "LCD RST (-1 when driven by the TCA9554 expander)"
            default -1
        config BSP_LCD_PIN_BL
            int "Backlight GPIO (-1 when driven by the TCA9554 expander)"
            default -1
        config BSP_LCD_PIXEL_CLOCK_HZ
            int "SPI pixel clock (Hz)"
            default 40000000
        config BSP_LCD_H_RES
            int "Horizontal resolution"
            default 320
        config BSP_LCD_V_RES
            int "Vertical resolution"
            default 480
        config BSP_LCD_SWAP_XY
            bool "Swap X/Y (landscape)"
            default y
        config BSP_LCD_MIRROR_X
            bool "Mirror X"
            default y
        config BSP_LCD_MIRROR_Y
            bool "Mirror Y"
            default n
        config BSP_LCD_BGR_ELEMENT_ORDER
            bool "Panel uses BGR element order"
            default y
    endmenu

    menu "System I2C bus"
        comment "Shared by FT6336 touch, TCA9554, AXP2101, PCF85063, QMI8658, ES8311"
        config BSP_I2C_PORT
            int "I2C port"
            range 0 1
            default 0
        config BSP_I2C_PIN_SDA
            int "I2C SDA"
            default 8
        config BSP_I2C_PIN_SCL
            int "I2C SCL"
            default 7
        config BSP_I2C_FREQ_HZ
            int "I2C clock (Hz)"
            default 400000
    endmenu

    menu "Touch (FT6336)"
        config BSP_TOUCH_PIN_INT
            int "Touch INT (-1 to poll)"
            default 4
        config BSP_TOUCH_PIN_RST
            int "Touch RST (-1 when driven by the expander)"
            default -1
    endmenu

    menu "IO expander (TCA9554)"
        config BSP_USE_IO_EXPANDER
            bool "Board has a TCA9554 expander"
            default y
        config BSP_IO_EXPANDER_ADDR
            hex "TCA9554 7-bit address"
            default 0x20
        config BSP_IO_EXP_BIT_LCD_RST
            int "Expander bit driving LCD RST (-1 if unused)"
            default 0
        config BSP_IO_EXP_BIT_LCD_BL
            int "Expander bit driving the backlight enable (-1 if unused)"
            default 1
        config BSP_IO_EXP_BIT_TP_RST
            int "Expander bit driving touch RST (-1 if unused)"
            default 2
        config BSP_IO_EXP_BIT_CAM_PWDN
            int "Expander bit driving CAM_PWDN (-1 if unused)"
            default 3
    endmenu

    menu "Camera (DVP -- OV5640 / OV2640)"
        comment "These match the Waveshare wiki pin table"
        config BSP_CAM_PIN_XCLK
            int "XCLK"
            default 38
        config BSP_CAM_PIN_PCLK
            int "PCLK"
            default 41
        config BSP_CAM_PIN_VSYNC
            int "VSYNC"
            default 17
        config BSP_CAM_PIN_HREF
            int "HREF"
            default 18
        config BSP_CAM_PIN_D0
            int "D0 (Y2)"
            default 45
        config BSP_CAM_PIN_D1
            int "D1 (Y3)"
            default 47
        config BSP_CAM_PIN_D2
            int "D2 (Y4)"
            default 48
        config BSP_CAM_PIN_D3
            int "D3 (Y5)"
            default 46
        config BSP_CAM_PIN_D4
            int "D4 (Y6)"
            default 42
        config BSP_CAM_PIN_D5
            int "D5 (Y7)"
            default 40
        config BSP_CAM_PIN_D6
            int "D6 (Y8)"
            default 39
        config BSP_CAM_PIN_D7
            int "D7 (Y9)"
            default 21
        config BSP_CAM_PIN_SIOD
            int "SIOD (SCCB SDA -- shared with the system I2C bus)"
            default 8
        config BSP_CAM_PIN_SIOC
            int "SIOC (SCCB SCL -- shared with the system I2C bus)"
            default 7
        config BSP_CAM_PIN_PWDN
            int "PWDN (-1 when driven by the expander or tied off)"
            default -1
        config BSP_CAM_PIN_RESET
            int "RESET (-1 when tied off)"
            default -1
        config BSP_CAM_XCLK_FREQ_HZ
            int "XCLK frequency (Hz)"
            default 20000000
    endmenu

    menu "TF card (SDMMC, 1-bit)"
        config BSP_SD_PIN_CLK
            int "SDMMC CLK"
            default 14
        config BSP_SD_PIN_CMD
            int "SDMMC CMD"
            default 15
        config BSP_SD_PIN_D0
            int "SDMMC D0"
            default 16
        config BSP_SD_FORMAT_IF_MOUNT_FAILED
            bool "Format the card if it cannot be mounted"
            default n
    endmenu

    menu "RS485 / Modbus-RTU UART"
        config BSP_RS485_UART_NUM
            int "UART port"
            range 1 2
            default 1
        config BSP_RS485_PIN_TX
            int "RS485 TX"
            default 43
        config BSP_RS485_PIN_RX
            int "RS485 RX"
            default 44
        config BSP_RS485_PIN_DE
            int "RS485 DE/RE direction pin (-1 for auto-direction transceivers)"
            default 13
    endmenu

    menu "General-purpose UART (console page)"
        config BSP_UART_NUM
            int "UART port"
            range 1 2
            default 2
        config BSP_UART_PIN_TX
            int "TX"
            default 9
        config BSP_UART_PIN_RX
            int "RX"
            default 10
    endmenu

    config BSP_BUZZER_PIN
        int "Buzzer / alert GPIO (-1 if none)"
        default -1

    menu "Access control (RC522 reader + door lock)"

        config BSP_RC522_ENABLED
            bool "MFRC522 RFID reader"
            default y
            help
                The reader shares the LCD's SPI bus and only needs its own
                chip select. The display must be initialised first, because
                it is what brings the bus up.

                The LCD itself never reads, so a board may not break MISO out
                to a header even though the pin is assigned. The RC522 does
                need it -- check that before wiring.

        config BSP_RC522_PIN_CS
            int "RC522 chip select"
            depends on BSP_RC522_ENABLED
            default 6

        config BSP_RC522_PIN_RST
            int "RC522 reset (-1 to tie the pin to 3V3)"
            depends on BSP_RC522_ENABLED
            default -1
            help
                With no reset line the driver issues a soft reset over SPI,
                which is enough in practice. Wire one only if you have a pin
                to spare, which on this board you do not.

        config BSP_RC522_SPI_CLOCK_HZ
            int "RC522 SPI clock (Hz)"
            depends on BSP_RC522_ENABLED
            range 1000000 10000000
            default 5000000
            help
                The MFRC522 is rated to 10 MHz. 5 MHz is well inside spec and
                leaves margin for the jumper wires this is usually built with.
                The LCD keeps its own, much faster clock -- the SPI driver
                reconfigures per transaction.

        config BSP_LOCK_PIN
            int "Door strike / relay GPIO (-1 if none)"
            default 11
            help
                WIRING: this pin floats during reset and for the first few
                milliseconds of boot. Fit a pull-down resistor (10k) to the
                relay input, or the door can unlock every time the panel
                reboots. If the relay module is active-low, fit a pull-up and
                untick "Lock output is active high" below.

        config BSP_LOCK_ACTIVE_HIGH
            bool "Lock output is active high"
            default y
            help
                Tick when driving the pin high energises the strike. Most
                small relay boards are active low, so check yours.

    endmenu

endmenu
```

## sdkconfig.defaults
```kconfig
# ---------------------------------------------------------------------------
# Target / toolchain
# ---------------------------------------------------------------------------
CONFIG_IDF_TARGET="esp32s3"
CONFIG_IDF_EXPERIMENTAL_FEATURES=y

# GCC has a known ICE in esp_lcd_panel_rgb.c when built with the debug profile
# (-Og). Use a non-debug optimization level to keep the downstream RGB panel
# driver compiling reliably on ESP-IDF v5.3.x.
CONFIG_COMPILER_OPTIMIZATION_SIZE=y
# CONFIG_COMPILER_OPTIMIZATION_DEBUG is not set
# CONFIG_COMPILER_OPTIMIZATION_PERF is not set
# CONFIG_COMPILER_OPTIMIZATION_NONE is not set
CONFIG_COMPILER_OPTIMIZATION_ASSERTIONS_ENABLE=y
# CONFIG_COMPILER_OPTIMIZATION_ASSERTIONS_SILENT is not set
# CONFIG_COMPILER_OPTIMIZATION_ASSERTIONS_DISABLE is not set
CONFIG_COMPILER_OPTIMIZATION_ASSERTION_LEVEL=2
# CONFIG_COMPILER_CXX_EXCEPTIONS is not set
CONFIG_OPTIMIZATION_LEVEL_RELEASE=y
# CONFIG_OPTIMIZATION_LEVEL_DEBUG is not set
# CONFIG_COMPILER_OPTIMIZATION_LEVEL_DEBUG is not set
# CONFIG_COMPILER_OPTIMIZATION_LEVEL_RELEASE is not set

# ---------------------------------------------------------------------------
# Flash: 16 MB, QIO @ 80 MHz  (W25Q128JVSIQ)
# ---------------------------------------------------------------------------
CONFIG_ESPTOOLPY_FLASHMODE_QIO=y
CONFIG_ESPTOOLPY_FLASHFREQ_80M=y
CONFIG_ESPTOOLPY_FLASHSIZE_16MB=y
CONFIG_PARTITION_TABLE_CUSTOM=y
CONFIG_PARTITION_TABLE_CUSTOM_FILENAME="partitions.csv"

# ---------------------------------------------------------------------------
# PSRAM: 8 MB octal @ 80 MHz. The camera frame buffers, the LVGL draw buffers
# and the AVI writer cache all live here -- without it nothing fits.
# ---------------------------------------------------------------------------
CONFIG_SPIRAM=y
CONFIG_SPIRAM_MODE_OCT=y
CONFIG_SPIRAM_SPEED_80M=y
CONFIG_SPIRAM_FETCH_INSTRUCTIONS=y
CONFIG_SPIRAM_RODATA=y
CONFIG_SPIRAM_USE_MALLOC=y
CONFIG_SPIRAM_MALLOC_ALWAYSINTERNAL=4096
CONFIG_SPIRAM_TRY_ALLOCATE_WIFI_LWIP=y

# ---------------------------------------------------------------------------
# CPU / RTOS
# ---------------------------------------------------------------------------
CONFIG_ESP_DEFAULT_CPU_FREQ_MHZ_240=y
CONFIG_FREERTOS_HZ=1000
CONFIG_ESP_MAIN_TASK_STACK_SIZE=6144
CONFIG_ESP_SYSTEM_EVENT_TASK_STACK_SIZE=4096
CONFIG_ESP_TIMER_TASK_STACK_SIZE=4096

# Camera DMA + LCD flush both benefit from IRAM-resident ISRs.
CONFIG_ESP32S3_DATA_CACHE_LINE_64B=y

# ---------------------------------------------------------------------------
# Camera (espressif/esp32-camera)
# ---------------------------------------------------------------------------
CONFIG_OV5640_SUPPORT=y
CONFIG_OV2640_SUPPORT=y
CONFIG_CAMERA_TASK_STACK_SIZE=4096
CONFIG_CAMERA_CORE1=y
CONFIG_SCCB_HARDWARE_I2C_PORT0=y

# ---------------------------------------------------------------------------
# FATFS on the TF card: long file names, UTF-8, decent sector cache
# ---------------------------------------------------------------------------
CONFIG_FATFS_LFN_HEAP=y
CONFIG_FATFS_MAX_LFN=255
CONFIG_FATFS_API_ENCODING_UTF_8=y
CONFIG_FATFS_ALLOC_PREFER_EXTRAM=y

# ---------------------------------------------------------------------------
# LVGL 8.3
# ---------------------------------------------------------------------------
CONFIG_LV_COLOR_DEPTH_16=y
CONFIG_LV_COLOR_16_SWAP=y
CONFIG_LV_MEM_CUSTOM=y
CONFIG_LV_MEMCPY_MEMSET_STD=y
CONFIG_LV_ATTRIBUTE_FAST_MEM_USE_IRAM=y
CONFIG_LV_DISP_DEF_REFR_PERIOD=20
CONFIG_LV_INDEV_DEF_READ_PERIOD=20
CONFIG_LV_FONT_MONTSERRAT_12=y
CONFIG_LV_FONT_MONTSERRAT_14=y
CONFIG_LV_FONT_MONTSERRAT_16=y
CONFIG_LV_FONT_MONTSERRAT_20=y
CONFIG_LV_FONT_MONTSERRAT_24=y
CONFIG_LV_FONT_MONTSERRAT_32=y
CONFIG_LV_FONT_MONTSERRAT_48=y
CONFIG_LV_USE_PERF_MONITOR=n

# ---------------------------------------------------------------------------
# Networking (Modbus-TCP, webhook notifications). The clock is set by hand.
# ---------------------------------------------------------------------------
CONFIG_LWIP_SO_RCVBUF=y
CONFIG_LWIP_MAX_SOCKETS=16
CONFIG_ESP_WIFI_STATIC_RX_BUFFER_NUM=8
CONFIG_ESP_WIFI_DYNAMIC_RX_BUFFER_NUM=32
CONFIG_ESP_WIFI_TX_BUFFER_TYPE=1
CONFIG_ESP_WIFI_DYNAMIC_TX_BUFFER_NUM=32
CONFIG_MBEDTLS_DYNAMIC_BUFFER=y

# ---------------------------------------------------------------------------
# Logging
# ---------------------------------------------------------------------------
CONFIG_LOG_DEFAULT_LEVEL_INFO=y
CONFIG_LOG_MAXIMUM_LEVEL_DEBUG=y
CONFIG_BOOTLOADER_LOG_LEVEL_WARN=y

# ---------------------------------------------------------------------------
# Watchdogs: the LVGL task legitimately hogs a core during a full redraw.
# ---------------------------------------------------------------------------
CONFIG_ESP_TASK_WDT_TIMEOUT_S=10
CONFIG_ESP_INT_WDT_TIMEOUT_MS=800
```
